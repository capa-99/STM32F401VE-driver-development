# file: STM32F401VE SPI drivers.ioc
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Mcu.Family=STM32F4
Mcu.Name=STM32F401V(D-E)Hx
Mcu.Package=UFBGA100
NVIC.PriorityGroup=NVIC_PRIORITYGROUP_4
ProjectManager.HeapSize=0x200
ProjectManager.StackSize=0x400
ProjectManager.TargetToolchain=STM32CubeIDE
RCC.AHBFreq_Value=16000000
RCC.APB1Freq_Value=16000000
RCC.APB2Freq_Value=16000000
RCC.CortexFreq_Value=16000000
RCC.HSE_VALUE=25000000
RCC.HSI_VALUE=16000000
RCC.LSE_VALUE=32768
RCC.SYSCLKFreq_VALUE=16000000
RCC.VCOOutputFreq_Value=192000000
board=custom

// file: Core/Src/main.c
/* USER CODE BEGIN Header */
/**
  ******************************************************************************
  * @file           : main.c
  * @brief          : Main program body
  ******************************************************************************
  * @attention
  *
  * Copyright (c) 2024 STMicroelectronics.
  * All rights reserved.
  *
  * This software is licensed under terms that can be found in the LICENSE file
  * in the root directory of this software component.
  * If no LICENSE file comes with this software, it is provided AS-IS.
  *
  ******************************************************************************
  */
/* USER CODE END Header */
#include "main.h"

void SystemClock_Config(void);

/* USER CODE BEGIN 0 */

/*void SPI1_IRQHandler(void)
{
	 uint16_t rx_data = spi_dr_read(SPI1);

		    if(rx_data == 0x55)
		    {
		  	  GPIOD->ODR = 0x4;
		    }
		    else
		    {
		    	 GPIOD->ODR = 0x1;
		    }
}*/

/* USER CODE END 0 */

int main(void)
{

  /* MCU Configuration--------------------------------------------------------*/

  /* Reset of all peripherals, Initializes the Flash interface and the Systick. */
 // HAL_Init();

  /* Configure the system clock */
  SystemClock_Config();

  /* Initialize all configured peripherals */

  /* Infinite loop */
  /* USER CODE BEGIN WHILE */

  /*int mstr = 1;

  if(mstr)
  {

	  	RCC->AHB1ENR = RCC->AHB1ENR | 0x1;
	    RCC->AHB1ENR = RCC->AHB1ENR | 0x8;

	    GPIOA->MODER = 0x00000000;
	    GPIOA->MODER = GPIOA->MODER | 0xAA00;
	    GPIOA->AFR[0] = GPIOA->AFR[0] | 0x55550000;

	    GPIOD->MODER = GPIOD->MODER | 0x0055;
	    GPIOD->ODR = 0x1;

	    spi_enable_interrupt(SPI1_IRQn);
	    spi_type spi1;
	    spi1.spi = SPI1;
		spi1.type = SPI1_TYPE;
		spi1.bidimode = SPI_BIDIMODE_UNI;
		spi1.bidioe = SPI_BIDIOE_DISABLED;
		spi1.crcen = SPI_CRCEN_DISABLED;
		spi1.crcnext = SPI_CRCNEXT_NO_PHASE;
		spi1.dff = SPI_DFF_8_BIT;
		spi1.rxonly = SPI_RXONLY_FULL_DUPLEX;
		spi1.ssm = SPI_SSM_DISABLED;
		spi1.ssi = SPI_SSI_SELECT;
		spi1.lsbfirst = SPI_LSBFIRST_MSB;
		spi1.spe = SPI_SPE_ENABLE;
		spi1.br = SPI_BR_64;
		spi1.mstr = SPI_MSTR_MASTER;
		spi1.cpol = SPI_CPOL_1;
		spi1.cpha = SPI_CPHA_SECOND;
		spi1.txeie = SPI_TXEIE_MASKED;
		spi1.rxneie = SPI_RXNEIE_NOT_MASKED;
		spi1.errie = SPI_ERRIE_MASKED;
		spi1.frf = SPI_FRF_MOTOROLA;
		spi1.ssoe = SPI_SSOE_ENABLED;
		spi1.txdmaen = SPI_TXDMAEN_DISABLED;
		spi1.rxdmaen = SPI_RXDMAEN_DISABLED;
		spi_configure(&spi1);

		spi_master_transmit(spi1.spi, 0xAA);

	    GPIOD->ODR = 0x2;

	    while(spi_sr_check_bsy(spi1.spi) == SPI_BSY_BUSY);

	    spi_cr1_configure_spe(spi1.spi, SPI_SPE_DISABLE);

  }
  else
  {
	  	RCC->AHB1ENR = RCC->AHB1ENR | 0x1;
	    RCC->AHB1ENR = RCC->AHB1ENR | 0x8;

	    GPIOA->MODER = 0x00000000;
	    GPIOA->MODER = GPIOA->MODER | 0xAA00;
	    GPIOA->AFR[0] = GPIOA->AFR[0] | 0x55550000;

	    GPIOD->MODER = GPIOD->MODER | 0x0055;
	    GPIOD->ODR = 0x1;

	    spi_type spi1;
	    spi1.spi = SPI1;
	    spi1.type = SPI1_TYPE;
	    spi1.bidimode = SPI_BIDIMODE_UNI;
	    spi1.bidioe = SPI_BIDIOE_DISABLED;
	    spi1.crcen = SPI_CRCEN_DISABLED;
	    spi1.crcnext = SPI_CRCNEXT_NO_PHASE;
	    spi1.dff = SPI_DFF_8_BIT;
	    spi1.rxonly = SPI_RXONLY_FULL_DUPLEX;
	    spi1.ssm = SPI_SSM_DISABLED;
	    spi1.ssi = SPI_SSI_SELECT;
	    spi1.lsbfirst = SPI_LSBFIRST_MSB;
	    spi1.spe = SPI_SPE_ENABLE;
	    spi1.br = SPI_BR_64;
	    spi1.mstr = SPI_MSTR_SLAVE;
	    spi1.cpol = SPI_CPOL_1;
	    spi1.cpha = SPI_CPHA_SECOND;
	    spi1.txeie = SPI_TXEIE_MASKED;
	    spi1.rxneie = SPI_RXNEIE_MASKED;
	    spi1.errie = SPI_ERRIE_MASKED;
	    spi1.frf = SPI_FRF_MOTOROLA;
	    spi1.ssoe = SPI_SSOE_ENABLED;
	    spi1.txdmaen = SPI_TXDMAEN_DISABLED;
	    spi1.rxdmaen = SPI_RXDMAEN_DISABLED;
	    spi_configure(&spi1);

	    spi_slave_transmit(spi1.spi, 0x55);
	    GPIOD->ODR = 0x2;

	    uint16_t rx_data = spi_slave_receive(spi1.spi);

	    if(rx_data == 0xAA)
	    {
	    	GPIOD->ODR = 0x4;
	    }
	    else
	    {
	       GPIOD->ODR = 0x1;
	    }

	    while(spi_sr_check_bsy(spi1.spi) == SPI_BSY_BUSY);

	    spi_cr1_configure_spe(spi1.spi, SPI_SPE_DISABLE);
  }
*/

  int mstr = 1;

  if(mstr)
  {
	  stoplight_initialize(STOPLIGHT_MASTER);
  }
  else
  {
	  stoplight_initialize(STOPLIGHT_SLAVE);

  }

  while (1)
  {

    /* USER CODE END WHILE */

    /* USER CODE BEGIN 3 */
  }

  	  return 0;
  /* USER CODE END 3 */
}

void SystemClock_Config(void)
{
  /*RCC_OscInitTypeDef RCC_OscInitStruct = {0};
  RCC_ClkInitTypeDef RCC_ClkInitStruct = {0};

  /** Configure the main internal regulator output voltage

  __HAL_RCC_PWR_CLK_ENABLE();
  __HAL_PWR_VOLTAGESCALING_CONFIG(PWR_REGULATOR_VOLTAGE_SCALE2);

  /** Initializes the RCC Oscillators according to the specified parameters
  * in the RCC_OscInitTypeDef structure.

  RCC_OscInitStruct.OscillatorType = RCC_OSCILLATORTYPE_HSI;
  RCC_OscInitStruct.HSIState = RCC_HSI_ON;
  RCC_OscInitStruct.HSICalibrationValue = RCC_HSICALIBRATION_DEFAULT;
  RCC_OscInitStruct.PLL.PLLState = RCC_PLL_NONE;
  if (HAL_RCC_OscConfig(&RCC_OscInitStruct) != HAL_OK)
  {
    Error_Handler();
  }

  /** Initializes the CPU, AHB and APB buses clocks

  RCC_ClkInitStruct.ClockType = RCC_CLOCKTYPE_HCLK|RCC_CLOCKTYPE_SYSCLK
                              |RCC_CLOCKTYPE_PCLK1|RCC_CLOCKTYPE_PCLK2;
  RCC_ClkInitStruct.SYSCLKSource = RCC_SYSCLKSOURCE_HSI;
  RCC_ClkInitStruct.AHBCLKDivider = RCC_SYSCLK_DIV1;
  RCC_ClkInitStruct.APB1CLKDivider = RCC_HCLK_DIV1;
  RCC_ClkInitStruct.APB2CLKDivider = RCC_HCLK_DIV1;

  if (HAL_RCC_ClockConfig(&RCC_ClkInitStruct, FLASH_LATENCY_0) != HAL_OK)
  {
    Error_Handler();
  }*/
}

void Error_Handler(void)
{
  __disable_irq();
  while (1)
  {
  }
}
